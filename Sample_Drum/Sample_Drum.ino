// Lo-Fi drum samples //

#define LED_PIN     13
#define LED_PORT    PORTB
#define LED_BIT     5

#define SAMPLE_RATE 88200
#define SIZE        256
#define BPM         120

  uint8_t out;
  uint16_t cnt, tmp;
  int bound;
  bool trig = false;
  int type = false;
  
const byte kick[SIZE] = {127, 80, 42, 5, 165, 242, 241, 233, 128, 73, 48, 22, 127,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 126, 126};
const byte snare[SIZE] = {127, 215, 65, 212, 56, 102, 135, 122, 51, 201, 220, 46, 175,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 126, 126};
const byte hat[SIZE] = {127, 128, 225, 217, 99, 38, 61, 153, 152, 144, 133, 73, 122,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 127, 127};
const byte crash[SIZE] = {127, 128, 225, 217, 99, 38, 61, 153, 152, 144, 133, 73, 122,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 127, 127};

int8_t fuzz(int8_t x, uint8_t clip, uint8_t gain) {
  
  float y = x * gain;            
  if(y > clip) y = clip;
  else if(y < -clip) y = -clip;
  return y;

}

ISR(TIMER1_COMPA_vect) {

  DALR = fuzz(out, 64, 1);
  
  if (type == 0) out = kick[cnt];
  if (type == 1) out = snare[cnt];
  if (type == 2) out = hat[cnt];
  if (type == 3) out = crash[cnt];

  if (trig) { trig = false; cnt = 0; } 
  if (tmp >= bound) { cnt++; tmp = 0; }
  if(cnt >= SIZE) { trig = false; out = 0; }
  
  tmp++;

}

void setup() {

  pinMode(LED_PIN, OUTPUT);

  analogReference(DEFAULT);
  pinMode(DAC0, ANALOG);

  cli();

  TCCR1B = (TCCR1B & ~_BV(WGM13)) | _BV(WGM12);
  TCCR1A = TCCR1A & ~(_BV(WGM11) | _BV(WGM10));
  TCCR1B = (TCCR1B & ~(_BV(CS12) | _BV(CS11))) | _BV(CS10);
  OCR1A = F_CPU / SAMPLE_RATE;
  TIMSK1 |= _BV(OCIE1A);

  sei();

}

void loop() {
    
  LED_PORT ^= 1 << LED_BIT;

  trig = true;
  type = random(0, 4);
  bound = random(4, 80);
   
  int tempo = 60000 / BPM;
  delay(tempo / 4);
  
}